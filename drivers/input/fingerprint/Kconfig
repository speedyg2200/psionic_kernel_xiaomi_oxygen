## drivers/input/fingerprint/Kconfig
```kconfig
config INPUT_FINGERPRINT
	tristate "Fingerprint driver support"
	help
	  Say Y here to enable fingerprint driver support.

if MACH_XIAOMI_C6
source "drivers/input/fingerprint/goodix_mido/Kconfig"
source "drivers/input/fingerprint/fpc_mido/Kconfig"
endif

if MACH_XIAOMI_OXYGEN
source "drivers/input/fingerprint/goodix_ta/Kconfig"
source "drivers/input/fingerprint/fpc_tee/Kconfig"
endif
```
